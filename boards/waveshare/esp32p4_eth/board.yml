## boards/waveshare/esp32p4_eth/board.yml
```yaml
board:
  name: waveshare_esp32p4_eth
  full_name: Waveshare ESP32-P4-ETH
  vendor: waveshare
  socs:
  - name: esp32p4
  revision:
    format: major.minor.patch
    default: "1.3.0"
    revisions:
    - name: "1.3.0"
    - name: "3.1.0"
```

## drivers/dai/nxp/sai/Kconfig.sai
```kconfig
# Copyright 2023 NXP
# SPDX-License-Identifier: Apache-2.0

config DAI_NXP_SAI
	bool "NXP Synchronous Audio Interface (SAI) driver"
	default y
	depends on DT_HAS_NXP_DAI_SAI_ENABLED
	select PINCTRL
	help
		Select this to enable NXP SAI driver.

if DAI_NXP_SAI

config SAI_HAS_MCLK_CONFIG_OPTION
	bool "Set if SAI has MCLK configuration options"
	default n
	help
		Select this if the SAI IP allows configuration
		of the master clock. Master clock configuration
		refers to enabling/disabling the master clock,
		setting the signal as input or output or dividing
		the master clock output.

config SAI_FIFO_WORD_SIZE
	int "Size (in bytes) of a FIFO word"
	default 4
	help
		Use this to set the size (in bytes) of a SAI
		FIFO word.

config DAI_NXP_SAI_STOP_ON_FIFO_ERROR
	bool "Halt a direction on a FIFO error"
	help
		A FIFO error (RX overrun, TX underrun) loses words from
		the middle of a frame. The SAI resumes at the next frame,
		but the partial frame stays in the stream, so every later
		word lands in the wrong slot: on a multichannel stream the
		channels are permanently swapped.

		By default the driver logs the error and carries on. With
		this option it halts the direction instead and moves it to
		DAI_STATE_ERROR, so no misaligned data follows. The consumer
		learns of it through dai_nxp_sai_set_error_callback() or
		dai_nxp_sai_get_status(), re-arms its DMA, and resumes the
		direction realigned with dai_nxp_sai_recover(), which keeps
		any bit clock and frame sync it generates running. A stop
		and restart also realigns it, but stops those clocks.

config SAI_IMX93_ERRATA_051421
	bool "Set if your SAI IP version is affected by i.MX93's ERRATA 051421"
	default n
	help
		Select this if your SAI ip version is affected by
		i.MX93's ERRATA 051421. The errata states that if
		the SAI is FSYNC/BCLK master, one of the directions
		is SYNC with the other, and the ASYNC direction has
		the BYP bit toggled, the SYNC direction's BCLK won't
		be generated properly.

endif # DAI_NXP_SAI
```

## drivers/ethernet/dwc_mac/Kconfig.ptp
```kconfig
# SPDX-FileCopyrightText: Copyright The Zephyr Project Contributors
# SPDX-License-Identifier: Apache-2.0

config PTP_CLOCK_DWC_MAC
	bool "DWC MAC PTP clock driver support"
	default y
	depends on PTP_CLOCK
	depends on DT_HAS_SNPS_DWMAC_PTP_CLOCK_ENABLED
	select NET_L2_PTP_TIMESTAMPING
	help
	  Enable PTP clock support for the Synopsys DesignWare MAC cores.

config PTP_CLOCK_DWC_MAC_RX_TIMESTAMP_ALL
	bool "Timestamp every received frame"
	depends on PTP_CLOCK_DWC_MAC && PTP
	help
	  With the PTP stack enabled, only PTP frames get a receive
	  timestamp. This also stamps every other frame, so applications can
	  read a received packet's arrival time at the MAC (for example
	  through SO_TIMESTAMPING) to measure network latency. PTP is
	  unaffected: its frames are stamped either way.
```

## drivers/i2s/Kconfig.esp32
```kconfig
# Copyright (c) 2024 Espressif Systems (Shanghai) CO LTD
#
# SPDX-License-Identifier: Apache-2.0

config I2S_ESP32
	bool "ESP32 I2S driver"
	default y
	depends on DT_HAS_ESPRESSIF_ESP32_I2S_ENABLED
	select DMA if DT_HAS_ESPRESSIF_ESP32_GDMA_ENABLED
	help
	  Enables the ESP32 I2S driver.

if I2S_ESP32

choice I2S_ESP32_CLK_SRC
	prompt "ESP32 I2S clock source"
	default I2S_ESP32_CLK_SRC_DEFAULT

config I2S_ESP32_CLK_SRC_DEFAULT
	bool "Default clock source of the SoC"
	help
	  The SoC's default I2S clock source; on ESP32-P4 the 160 MHz PLL.
	  The MCLK divider is fractional unless the PLL is a multiple of
	  MCLK.

config I2S_ESP32_CLK_SRC_APLL
	bool "Audio PLL"
	depends on SOC_SERIES_ESP32P4
	help
	  Clock I2S from the audio PLL, set at configure time to a multiple
	  of MCLK (at least twice MCLK, and at least the APLL's minimum
	  frequency) so the MCLK divider is an integer. The APLL is shared
	  with other peripherals: if another user already set it, I2S runs
	  from its current frequency, and audio rates that need a different
	  one come out wrong.

endchoice

config I2S_ESP32_RX_BLOCK_COUNT
	int "ESP32 I2S RX block count"
	default 5
	help
	  Max number of blocks waiting to be read from the I2S RX channel.

config I2S_ESP32_TX_BLOCK_COUNT
	int "ESP32 I2S TX block count"
	default 5
	help
	  Max number of blocks waiting to be transmitted by the I2S TX channel.

config I2S_ESP32_DMA_DESC_NUM_MAX
	int "ESP32 I2S number of link descriptors"
	default 10
	depends on !DT_HAS_ESPRESSIF_ESP32_GDMA_ENABLED
	help
	  Max number of link descriptor available for DMA transfers on each I2S channel

config I2S_ESP32_ALLOWED_EMPTY_TX_QUEUE_DEFERRAL_TIME_MS
	int "ESP32 I2S empty TX queue processing deferral time"
	default 0
	help
	  Allowed deferral time for processing an empty tx queue in milliseconds

endif
```

## dts/bindings/clock/nxp,imxrt-audio-pll.yaml
```yaml
# Copyright 2026 Sonance
# SPDX-License-Identifier: Apache-2.0

description: |
  NXP i.MX RT audio PLL, shared by all SAI peripherals on the SoC.

  Exposed as a clock_control device rather than a plain-data node so a SAI
  node can list it as one of its `clocks` entries, alongside its usual
  peripheral-gate clock: `clock_control_on()` is what actually configures
  it. The audio PLL itself is configured once, during this device's own
  init (regardless of how many SAI instances reference it); each `on()`
  call afterwards just selects the calling SAI instance's own root clock
  mux/divider, decoded from the single packed cell value (see
  include/zephyr/dt-bindings/clock/nxp_imxrt_audio_pll.h).

compatible: "nxp,imxrt-audio-pll"

include: [clock-controller.yaml, base.yaml]

properties:
  "#clock-cells":
    const: 1

  pll-src:
    type: int
    required: true
    description: audio PLL clock source selector

  loop-divider:
    type: int
    required: true
    description: audio PLL loop divider

  post-divider:
    type: int
    required: true
    description: audio PLL post divider

  numerator:
    type: int
    required: true
    description: audio PLL fractional loop divider numerator

  denominator:
    type: int
    required: true
    description: audio PLL fractional loop divider denominator

  loop-divider-44k1:
    type: int
    description: |
      Loop divider for the 44.1 kHz rate family, selected at runtime by
      nxp_imxrt_audio_pll_set_family(). The properties above describe the
      48 kHz family, which is also what the PLL is configured for at init.
      Omit both 44k1 properties on boards that only ever run one family.

  numerator-44k1:
    type: int
    description: |
      Fractional numerator for the 44.1 kHz rate family, over the same
      denominator as the 48 kHz family.

clock-cells:
  - name
```

## dts/bindings/i2c/nxp,lpi2c.yaml
```yaml
# Copyright (c) 2019, NXP
# SPDX-License-Identifier: Apache-2.0

description: NXP LPI2C controller

compatible: "nxp,lpi2c"

include: [i2c-controller.yaml, pinctrl-device.yaml]

properties:
  reg:
    required: true

  bus-idle-timeout:
    type: int
    description: Bus idle timeout in nanoseconds

  scl-glitch-filter-ns:
    type: int
    default: 0
    description: |
      Width in nanoseconds of the controller's SCL input glitch filter;
      pulses this short or shorter are ignored. The filter counts cycles
      of the LPI2C functional clock, up to 15, so the widest it can be is
      15 cycles of that clock. 0 disables it. Use it where crosstalk puts
      short pulses on SCL: an unfiltered controller can count one as a
      clock that a target ignores, and the two then disagree on the bit
      position.

  sda-glitch-filter-ns:
    type: int
    default: 0
    description: |
      Width in nanoseconds of the controller's SDA input glitch filter, as
      for scl-glitch-filter-ns. 0 disables it.

  scl-gpios:
    type: phandle-array
    description: |
      GPIO to which the I2C SCL signal is routed. This is only needed for I2C bus recovery
      support.

  sda-gpios:
    type: phandle-array
    description: |
      GPIO to which the I2C SDA signal is routed. This is only needed for I2C bus recovery
      support.
```

## soc/nxp/imxrt/imxrt11xx/Kconfig
```kconfig
# Copyright 2024 NXP
# SPDX-License-Identifier: Apache-2.0

config SOC_SERIES_IMXRT11XX
	select CPU_HAS_CUSTOM_FIXED_SOC_MPU_REGIONS
	select CPU_CORTEX_M_HAS_DWT
	select SOC_RESET_HOOK
	select ARM
	select CLOCK_CONTROL
	select HAS_MCUX_CACHE
	select HAS_MCUX
	select CPU_HAS_ARM_MPU
	select CPU_HAS_ICACHE if CPU_CORTEX_M7
	select CPU_HAS_DCACHE if CPU_CORTEX_M7
	select CPU_HAS_FPU
	select CPU_HAS_FPU_DOUBLE_PRECISION if CPU_CORTEX_M7
	select HAS_SWO
	select HAS_PM

config SOC_MIMXRT1176_CM4
	select CPU_CORTEX_M4
	select CPU_HAS_ICACHE
	select CPU_HAS_DCACHE
	select HAS_MCUX_LMEM_CACHE

config SOC_MIMXRT1176_CM7
	select CPU_CORTEX_M7

config SOC_MIMXRT1166_CM4
	select CPU_CORTEX_M4
	select CPU_HAS_ICACHE
	select CPU_HAS_DCACHE
	select HAS_MCUX_LMEM_CACHE

config SOC_MIMXRT1166_CM7
	select CPU_CORTEX_M7

if SOC_SERIES_IMXRT11XX

config MCUX_CORE_SUFFIX
	default "_cm7" if SOC_MIMXRT1176_CM7 || SOC_MIMXRT1166_CM7
	default "_cm4" if SOC_MIMXRT1176_CM4 || SOC_MIMXRT1166_CM4

config BYPASS_LDO_LPSR
	default y
	bool "Bypass LDO lpsr"

config ADJUST_LDO
	default y
	bool "Adjust LDO setting"

choice ENET_PTP_CLOCK_SOURCE
	prompt "ENET PTP clock source"
	default ENET_PTP_CLOCK_USE_RC48M
	depends on PTP_CLOCK_NXP_ENET
	help
	  Source of ENET_TIMER1_CLK_ROOT, which clocks the ENET IEEE 1588
	  timer.

config ENET_PTP_CLOCK_USE_RC48M
	bool "Internal 48 MHz RC oscillator divided by two (24 MHz)"

config ENET_PTP_CLOCK_USE_XTAL
	bool "External 24 MHz crystal"
	help
	  Use the external 24 MHz crystal oscillator instead of the internal
	  48 MHz RC oscillator divided by two for the ENET timestamp clock.
	  Both sources provide a nominal 24 MHz clock, but a crystal generally
	  offers better long-term frequency stability for PTP synchronization.

config ENET_PTP_CLOCK_USE_SYS_PLL1
	bool "SYS_PLL1 divided by 2 and by 20 (25 MHz)"
	depends on ETH_NXP_ENET
	help
	  Clock the timer at 25 MHz from SYS_PLL1_DIV2, the source of the
	  ENET reference clock. SYS_PLL1 is locked to the 24 MHz crystal, so
	  the stability is the crystal's. At 24 MHz a tick is 41.667 ns, and
	  holding the nominal rate already takes the timer's correction
	  mechanism, leaving rate adjustment steps of about 60 ppm. A 25 MHz
	  tick is exactly 40 ns, which leaves the 31-bit correction period
	  free for adjustment, giving steps far below 1 ppm.

endchoice

config INIT_VIDEO_PLL
	default y

config SYS_PLL2_PFD0_DIV
	int "System PLL2 PFD0 divider"
	default 27
	range 13 35

config SYS_PLL2_PFD1_DIV
	int "System PLL2 PFD1 divider"
	default 16
	range 13 35

config SYS_PLL2_PFD2_DIV
	int "System PLL2 PFD2 divider"
	default 24
	range 13 35

config SYS_PLL2_PFD3_DIV
	int "System PLL2 PFD3 divider"
	default 32
	range 13 35

config SYS_PLL3_PFD0_DIV
	int "System PLL3 PFD0 divider"
	default 13
	range 13 35

config SYS_PLL3_PFD1_DIV
	int "System PLL3 PFD1 divider"
	default 17
	range 13 35

config SYS_PLL3_PFD2_DIV
	int "System PLL3 PFD2 divider"
	default 32
	range 13 35

config SYS_PLL3_PFD3_DIV
	int "System PLL3 PFD3 divider"
	default 22
	range 13 35

endif # SOC_SERIES_IMXRT11XX
```

## subsys/dap/Kconfig
```kconfig
# Copyright (c) 2018-2019 PHYTEC Messtechnik GmbH
# SPDX-License-Identifier: Apache-2.0

menuconfig DAP
	bool "Debug Access Port support [EXPERIMENTAL]"
	select EXPERIMENTAL
	select DP_DRIVER
	help
	  Debug Access Port support (currently CMSIS DAP only)

if DAP

config CMSIS_DAP_PACKET_COUNT
	int "Maximum packet buffers for request and response data."
	default 4
	range 1 $(UINT8_MAX)
	help
	  Maximum packet buffers for request and response data.

config CMSIS_DAP_PROBE_VENDOR
	string "Probe vendor"
	default "Zephyr"

config CMSIS_DAP_PROBE_NAME
	string "Probe name"
	default "CMSIS-DAP"

config CMSIS_DAP_BOARD_VENDOR
	string "Target board vendor"
	default ""

config CMSIS_DAP_BOARD_NAME
	string "Target board name"
	default ""

config CMSIS_DAP_DEVICE_VENDOR
	string "Target device vendor"
	default ""

config CMSIS_DAP_DEVICE_NAME
	string "Target device name"
	default ""

config DAP_BACKEND_USB
	bool "USB backend"
	depends on USB_DEVICE_STACK_NEXT
	help
	  DAP USB backend using bulk endpoints.

config DAP_BACKEND_TCP
	bool "TCP backend"
	depends on NET_SOCKETS && NET_TCP && NET_IPV4
	select NET_CONTEXT_SNDTIMEO
	help
	  DAP backend that serves one CMSIS-DAP client over TCP, using the
	  framing of the OpenOCD cmsis-dap tcp backend: an 8-byte little-endian
	  header (signature "DAP\0", 16-bit payload length, packet type and a
	  reserved byte) followed by one CMSIS-DAP request or response.

if DAP_BACKEND_TCP

config DAP_BACKEND_TCP_PORT
	int "TCP port"
	default 4441
	range 1 65535

config DAP_BACKEND_TCP_PKT_SIZE
	int "Packet size"
	default 1024
	range 64 4096
	help
	  CMSIS-DAP packet size reported to the host. Larger packets let the
	  host batch more transfers per network round trip.

config DAP_BACKEND_TCP_STACK_SIZE
	int "Thread stack size"
	default 3072

config DAP_BACKEND_TCP_THREAD_PRIORITY
	int "Thread priority"
	default 7

config DAP_BACKEND_TCP_SEND_TIMEOUT_MS
	int "Send timeout in milliseconds"
	default 5000
	help
	  The client is dropped when a response cannot be sent within this
	  time.

config DAP_BACKEND_TCP_KEEPALIVE
	bool "TCP keepalive"
	default y
	depends on NET_TCP_KEEPALIVE
	help
	  Probe idle clients so that a host which disappears without closing
	  the connection releases the debug port.

endif # DAP_BACKEND_TCP

module = DAP
module-str = dap
source "subsys/logging/Kconfig.template.log_config"

endif # DAP
```
